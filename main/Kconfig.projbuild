## main/Kconfig.projbuild
```kconfig
menu "JoMo Hardware Configuration"

    config JOMO_ADC1_CHANNEL_JOYSTICK_VRX
        int "Joystick VRX LP ADC1 Channel"
        default 0
        range 0 7
        help
            Select the channel to be used for the joystick X axis

    config JOMO_ADC1_CHANNEL_JOYSTICK_VRY
        int "Joystick VRY LP ADC1 Channel"
        default 1
        range 0 7
        help
            Select the channel to be used for the joystick Y axis

    config JOMO_SCROLL_GPIO
        int "Scroll button GPIO"
        default 2
        range 0 21
        help
            Select the GPIO to be used for the scroll button

    config JOMO_BUTTON1_GPIO
        int "Mouse Button 1 GPIO"
        default 3
        range 0 21
        help
            Select the GPIO to be used as Mouse button 1

    config JOMO_BUTTON2_GPIO
        int "Mouse Button 2 GPIO"
        default 4
        range 0 21
        help
            Select the GPIO to be used as Mouse button 2

endmenu
```
